## examples/esp32_deflate_example/sdkconfig.defaults
```kconfig
CONFIG_IDF_TARGET="esp32"
CONFIG_SERIAL_FLASHER_MD5_ENABLED=y
CONFIG_SERIAL_FLASHER_PORT_UART=y
```

## examples/esp32_runtime_interface_switching_example/main/Kconfig.projbuild
```kconfig
menu "Runtime Interface Switching Example Configuration"

    comment "Default pin assignments target the ESP32-P4-Function-EV-Board"

    menu "SDIO interface"

        config EXAMPLE_SDIO_RESET_PIN
            int "SDIO target reset GPIO"
            range 0 56
            default 54

        config EXAMPLE_SDIO_BOOT_PIN
            int "SDIO target boot GPIO"
            range 0 56
            default 53

        config EXAMPLE_SDIO_D0_PIN
            int "SDIO D0 GPIO"
            range 0 56
            default 50

        config EXAMPLE_SDIO_D1_PIN
            int "SDIO D1 GPIO"
            range 0 56
            default 49

        config EXAMPLE_SDIO_D2_PIN
            int "SDIO D2 GPIO"
            range 0 56
            default 48

        config EXAMPLE_SDIO_D3_PIN
            int "SDIO D3 GPIO"
            range 0 56
            default 47

        config EXAMPLE_SDIO_CLK_PIN
            int "SDIO CLK GPIO"
            range 0 56
            default 51

        config EXAMPLE_SDIO_CMD_PIN
            int "SDIO CMD GPIO"
            range 0 56
            default 52

    endmenu

    menu "UART interface"

        config EXAMPLE_UART_TX_PIN
            int "UART TX GPIO"
            range 0 56
            default 5

        config EXAMPLE_UART_RX_PIN
            int "UART RX GPIO"
            range 0 56
            default 6

        config EXAMPLE_UART_RESET_PIN
            int "UART target reset GPIO"
            range 0 56
            default 24

        config EXAMPLE_UART_BOOT_PIN
            int "UART target boot GPIO"
            range 0 56
            default 25

    endmenu

    menu "USB interface"

        config EXAMPLE_USB_PERIPHERAL_INDEX
            int "USB host peripheral index"
            range 0 1
            default 0
            help
                Selects which USB OTG peripheral the USB host driver uses.
                The value is converted to the peripheral_map bitmask as
                BIT(EXAMPLE_USB_PERIPHERAL_INDEX), so 0 maps to BIT0 and
                1 maps to BIT1.

    endmenu

endmenu
```

## examples/esp32_runtime_interface_switching_example/sdkconfig.defaults
```kconfig
CONFIG_IDF_TARGET="esp32p4"
CONFIG_SERIAL_FLASHER_PORT_SDIO=y
CONFIG_SERIAL_FLASHER_PORT_UART=y
CONFIG_SERIAL_FLASHER_PORT_USB_CDC_ACM=y
```

## examples/esp32_sdio_load_ram_example/sdkconfig.defaults
```kconfig
CONFIG_IDF_TARGET="esp32p4"
CONFIG_PARTITION_TABLE_CUSTOM=y
CONFIG_SERIAL_FLASHER_PORT_SDIO=y
```

## examples/esp32_usb_cdc_acm_example/sdkconfig.defaults
```kconfig
CONFIG_IDF_TARGET="esp32s3"
CONFIG_PARTITION_TABLE_CUSTOM=y
CONFIG_SERIAL_FLASHER_PORT_USB_CDC_ACM=y
```

## zephyr/dts/bindings/misc/esp-loader/espressif,esp-loader.yaml
```yaml
# SPDX-FileCopyrightText: 2026 Espressif Systems (Shanghai) CO LTD
# SPDX-License-Identifier: Apache-2.0

description: |
  ESP Serial Flasher target interface. Controls a target ESP SoC over UART
  using two GPIOs (reset and boot strapping) to enter and exit the ROM
  download mode. Configure one node per target device; select the active
  instance via the zephyr,esp-loader chosen property.

compatible: "espressif,esp-loader"

include:
  - base.yaml

properties:
  uart:
    type: phandle
    required: true
    description: UART node used for ROM protocol communication with the target.

  reset-gpios:
    type: phandle-array
    required: true
    description: |
      GPIO connected to the target EN/RST pin. Driven low to hold the target
      in reset, then released to start execution. Use GPIO_ACTIVE_LOW when
      the signal is inverted by external hardware.

  boot-gpios:
    type: phandle-array
    required: true
    description: |
      GPIO connected to the target IO0/BOOT pin. Driven low before releasing
      reset to force the target into ROM download mode. Use GPIO_ACTIVE_LOW
      when the signal is inverted by external hardware.

  default-baudrate:
    type: int
    required: true
    description: Initial UART baud rate used during ROM handshake and flashing.

  higher-baudrate:
    type: int
    required: true
    description: |
      Optional higher baud rate negotiated with the target after a successful
      connection to speed up flashing. Set to 0 to stay at default-baudrate.

  num-trials:
    type: int
    required: true
    description: Number of sync attempts before esp_loader_connect() gives up.

  sync-timeout-ms:
    type: int
    required: true
    description: Timeout in milliseconds for each individual sync attempt.
```
